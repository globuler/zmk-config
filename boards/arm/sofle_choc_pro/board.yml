## boards/arm/sofle_choc_pro/board.yml
```yaml
board:
  name: sofle_choc_pro_left
  vendor: keebart
  socs:
    - name: nrf52840
---
board:
  name: sofle_choc_pro_right
  vendor: keebart
  socs:
    - name: nrf52840
```
